## boards/shields/TOTEM/Kconfig.shield
```kconfig
config SHIELD_TOTEM_LEFT
    def_bool $(shields_list_contains,TOTEM_left)

config SHIELD_TOTEM_RIGHT
    def_bool $(shields_list_contains,TOTEM_right)
```
